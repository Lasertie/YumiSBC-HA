## buildroot-external/configs/yumi_sbc_defconfig
```kconfig
# Smart Pi Defconfig
BR2_ARM_CPU_PART_ALLWINNER_H3=y
BR2_ARM_CPU_ALLWINNER_H3=y
BR2_TOOLCHAIN_EXTERNAL=y
BR2_TOOLCHAIN_EXTERNAL_CUSTOM=y
BR2_TOOLCHAIN_EXTERNAL_CUSTOM_PREFIX="/path/to/your/toolchain"
BR2_PACKAGE_PYTHON3=y
BR2_PACKAGE_PYTHON_SQLITE3=y
BR2_PACKAGE_HOME_ASSISTANT=y
```
